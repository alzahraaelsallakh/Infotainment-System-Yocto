## yocto/build/conf/bblayers.conf
```bitbake
# POKY_BBLAYERS_CONF_VERSION is increased each time build/conf/bblayers.conf
# changes incompatibly
POKY_BBLAYERS_CONF_VERSION = "2"

BBPATH = "${TOPDIR}"
BBFILES ?= ""

BBLAYERS ?= " \
  /media/Stuff/InfotainmentSystem/Infotainment-System-Yocto/yocto/poky/meta \
  /media/Stuff/InfotainmentSystem/Infotainment-System-Yocto/yocto/poky/meta-poky \
  /media/Stuff/InfotainmentSystem/Infotainment-System-Yocto/yocto/poky/meta-yocto-bsp \
  /media/Stuff/InfotainmentSystem/Infotainment-System-Yocto/yocto/meta-raspberrypi \
  "
```

## yocto/meta-customInfotainment/conf/layer.conf
```bitbake
# We have a conf and classes directory, add to BBPATH
BBPATH .= ":${LAYERDIR}"

# We have recipes-* directories, add to BBFILES
BBFILES += "${LAYERDIR}/recipes-*/*/*.bb \
            ${LAYERDIR}/recipes-*/*/*.bbappend"

BBFILE_COLLECTIONS += "meta-customInfotainment"
BBFILE_PATTERN_meta-customInfotainment = "^${LAYERDIR}/"
BBFILE_PRIORITY_meta-customInfotainment = "6"

LAYERDEPENDS_meta-customInfotainment = "core"
LAYERSERIES_COMPAT_meta-customInfotainment = "warrior zeus"
```

## yocto/rpi-build/conf/bblayers.conf
```bitbake
# POKY_BBLAYERS_CONF_VERSION is increased each time build/conf/bblayers.conf
# changes incompatibly
POKY_BBLAYERS_CONF_VERSION = "2"

BBPATH = "${TOPDIR}"
BBFILES ?= ""

BBLAYERS ?= " \
  /media/Stuff/InfotainmentSystem/Infotainment-System-Yocto/yocto/poky/meta \
  /media/Stuff/InfotainmentSystem/Infotainment-System-Yocto/yocto/poky/meta-poky \
  /media/Stuff/InfotainmentSystem/Infotainment-System-Yocto/yocto/poky/meta-yocto-bsp \
  /media/Stuff/InfotainmentSystem/Infotainment-System-Yocto/yocto/meta-raspberrypi \
  /media/Stuff/InfotainmentSystem/Infotainment-System-Yocto/yocto/meta-customInfotainment \
  /media/Stuff/InfotainmentSystem/Infotainment-System-Yocto/yocto/meta-openembedded/meta-oe \
  /media/Stuff/InfotainmentSystem/Infotainment-System-Yocto/yocto/meta-openembedded/meta-python \
  /media/Stuff/InfotainmentSystem/Infotainment-System-Yocto/yocto/meta-openembedded/meta-networking \
  /media/Stuff/InfotainmentSystem/Infotainment-System-Yocto/yocto/meta-openembedded/meta-multimedia \ 
  /media/Stuff/InfotainmentSystem/Infotainment-System-Yocto/yocto/meta-qt5 \
  "
```
